1s
Run west build -s zmk/app -d "/tmp/tmp.JkdCDsqOlw" -b "seeeduino_xiao_ble"  -- -DZMK_CONFIG=/tmp/zmk-config/config -DSHIELD="roBa_L" -DZMK_EXTRA_MODULES='/__w/zmk-config-roBa/zmk-config-roBa' 
+ west build -s zmk/app -d /tmp/tmp.JkdCDsqOlw -b seeeduino_xiao_ble -- -DZMK_CONFIG=/tmp/zmk-config/config -DSHIELD=roBa_L -DZMK_EXTRA_MODULES=/__w/zmk-config-roBa/zmk-config-roBa
-- west build: generating a build system
Loading Zephyr default modules (Zephyr base).
-- Application: /tmp/zmk-config/zmk/app
-- CMake version: 3.31.6
-- Found Python3: /usr/bin/python3 (found suitable version "3.12.3", minimum required is "3.8") found components: Interpreter
-- Cache files will be written to: /tmp/zmk-config/zephyr/.cache
-- Zephyr version: 3.5.0 (/tmp/zmk-config/zephyr)
-- Found west (found suitable version "1.5.0", minimum required is "0.14.0")
-- Adding /__w/zmk-config-roBa/zmk-config-roBa/boards/shields/roBa
-- ZMK Config directory: /tmp/zmk-config/config
-- Using keymap file: /tmp/zmk-config/config/roBa.keymap
-- Board: seeeduino_xiao_ble
-- Shield(s): roBa_L
-- ZEPHYR_TOOLCHAIN_VARIANT not set, trying to locate Zephyr SDK
-- Found host-tools: zephyr 0.16.9 (/opt/zephyr-sdk-0.16.9)
-- Found toolchain: zephyr 0.16.9 (/opt/zephyr-sdk-0.16.9)
-- Found Dtc: /opt/zephyr-sdk-0.16.9/sysroots/x86_64-pokysdk-linux/usr/bin/dtc (found suitable version "1.6.0", minimum required is "1.4.6")
-- Found BOARD.dts: /tmp/zmk-config/zephyr/boards/arm/seeeduino_xiao_ble/seeeduino_xiao_ble.dts
-- Found devicetree overlay: /tmp/zmk-config/zmk/app/boards/seeeduino_xiao_ble.overlay
-- Found devicetree overlay: /__w/zmk-config-roBa/zmk-config-roBa/boards/shields/roBa/roBa_L.overlay
-- Found devicetree overlay: /tmp/zmk-config/config/roBa.keymap
devicetree error: /__w/zmk-config-roBa/zmk-config-roBa/boards/shields/roBa/roBa.dtsi:63 (column 50): parse error: expected number or parenthesized expression
CMake Error at /tmp/zmk-config/zephyr/cmake/modules/dts.cmake:279 (message):
-- In: /tmp/tmp.JkdCDsqOlw/zephyr, command: /usr/bin/python3;/tmp/zmk-config/zephyr/scripts/dts/gen_defines.py;--dts;/tmp/tmp.JkdCDsqOlw/zephyr/zephyr.dts.pre;--dtc-flags;'';--bindings-dirs;/tmp/zmk-config/zmk-pmw3610-driver/dts/bindings;/tmp/zmk-config/zmk/app/module/dts/bindings;/tmp/zmk-config/zmk/app/dts/bindings;/tmp/zmk-config/zephyr/dts/bindings;--header-out;/tmp/tmp.JkdCDsqOlw/zephyr/include/generated/devicetree_generated.h.new;--dts-out;/tmp/tmp.JkdCDsqOlw/zephyr/zephyr.dts.new;--edt-pickle-out;/tmp/tmp.JkdCDsqOlw/zephyr/edt.pickle;--vendor-prefixes;/tmp/zmk-config/zmk/app/dts/bindings/vendor-prefixes.txt;--vendor-prefixes;/tmp/zmk-config/zephyr/dts/bindings/vendor-prefixes.txt
  gen_defines.py failed with return code: 1
-- Configuring incomplete, errors occurred!
Call Stack (most recent call first):
  /tmp/zmk-config/zephyr/cmake/modules/zephyr_default.cmake:129 (include)
  /tmp/zmk-config/zephyr/share/zephyr-package/cmake/ZephyrConfig.cmake:66 (include)
  /tmp/zmk-config/zephyr/share/zephyr-package/cmake/ZephyrConfig.cmake:92 (include_boilerplate)
  CMakeLists.txt:9 (find_package)


FATAL ERROR: command exited with status 1: /usr/local/bin/cmake -DWEST_PYTHON=/usr/bin/python3 -B/tmp/tmp.JkdCDsqOlw -GNinja -DBOARD=seeeduino_xiao_ble -DZMK_CONFIG=/tmp/zmk-config/config -DSHIELD=roBa_L -DZMK_EXTRA_MODULES=/__w/zmk-config-roBa/zmk-config-roBa -S/tmp/zmk-config/zmk/app
Error: Process completed with exit code 1.
