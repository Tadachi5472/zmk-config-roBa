## config/west.yml
```yaml
manifest:
  remotes:
    - name: zmkfirmware
      url-base: https://github.com/zmkfirmware
    # 🔽 新しく「okunonishi」というリモート基地を独立して定義します（これが抜けていました）
    - name: okunonishi
      url-base: https://github.com/okunonishi

  projects:
    - name: zmk
      remote: zmkfirmware
      revision: main
      import: app/west.yml

    # 🔽 remoteに上で定義した「okunonishi」を指定し、自動合成で正しいURLになるようにします
    - name: zmk-pmw3610-driver
      remote: okunonishi
      revision: main
```
